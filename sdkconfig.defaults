## sdkconfig.defaults
```kconfig
# set default log level, 
#- 1 ERROR, log with ESP_LOGE
#- 2 WARNING, log with ESP_LOGW
#- 3 INFO, log with ESP_LOGI
#- 4 DEBUG, log with ESP_LOGD

CONFIG_LOG_DEFAULT_LEVEL=4
CONFIG_BT_ENABLED=y
CONFIG_BT_CONTROLLER_ENABLED=y
CONFIG_BT_NIMBLE_ENABLED=y
CONFIG_WIFI_SOCKET_ENABLED=y
CONFIG_HTTPD_WS_SUPPORT=y
CONFIG_WS_TRANSPORT=y
CONFIG_DAC_ENABLED=y
```
